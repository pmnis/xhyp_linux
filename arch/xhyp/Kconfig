## arch/xhyp/Kconfig
```kconfig
#
# For a description of the syntax of this configuration file,
# see Documentation/kbuild/kconfig-language.txt.
#

config XHYP
	def_bool y
	select IRQ_DOMAIN
	select HAVE_MEMBLOCK
	select ARCH_WANT_OPTIONAL_GPIOLIB
	select HAVE_ARCH_TRACEHOOK
	select HAVE_GENERIC_HARDIRQS
	select GENERIC_IRQ_CHIP
	select GENERIC_IRQ_PROBE
	select GENERIC_IRQ_SHOW
	select GENERIC_IOMAP
	select GENERIC_CPU_DEVICES
	select GENERIC_ATOMIC64
	select GENERIC_CLOCKEVENTS
	select KTIME_SCALAR
	select GENERIC_CALIBRATE_DELAY
	select GENERIC_STRNCPY_FROM_USER
	select GENERIC_STRNLEN_USER
	select AEABI
	select NO_DMA
	select ARCH_HAS_ILOG2_U32
	select HVC_DRIVER

config GENERIC_CALIBRATE_DELAY
	def_bool y

config KTIME_SCALAR
	bool
	default y

config ARCH_HAS_ILOG2_U32
	def_bool y

config NO_DMA
	def_bool y

config MMU
	def_bool y

config SYMBOL_PREFIX
	string
	default ""

config UID16
	def_bool y

config RWSEM_GENERIC_SPINLOCK
	def_bool y

config RWSEM_XCHGADD_ALGORITHM
	def_bool n

config GENERIC_HWEIGHT
	def_bool y

config NO_IOPORT
	def_bool y

config GENERIC_GPIO
	def_bool y

config TRACE_IRQFLAGS_SUPPORT
	def_bool y

# For now, use generic checksum functions
#These can be reimplemented in assembly later if so inclined
config GENERIC_CSUM
	def_bool y

config GENERIC_FIND_NEXT_BIT
	def_bool y

source "init/Kconfig"


menu "Processor type and features"

choice
	prompt "Subarchitecture"
	default ARM9

config ARM9
	bool "ARM9"
	select CPU_32v5
	help
	  Generic ARM9 architecture

endchoice


config	CPU_32v5
	bool

config AEABI
	bool "Use the ARM EABI to compile the kernel"
	help
	  This option allows for the kernel to be compiled using the latest
	  ARM ABI (aka EABI).  This is only useful if you are using a user
	  space environment that is also compiled with EABI.

	  Since there are major incompatibilities between the legacy ABI and
	  EABI, especially with regard to structure member alignment, this
	  option also changes the kernel syscall calling convention to
	  disambiguate both ABIs and allow for backward compatibility support
	  (selected with CONFIG_OABI_COMPAT).

	  To use this you need GCC version 4.0.0 or later.


config DRAM_BASE
	hex 'Base RAM address'
	default 0x00000000
	depends on ARM9
	help
	  Set to the base address of the Linux partition

config DRAM_SIZE
	hex 'Size of RAM'
	default 0x04000000
	depends on ARM9
	help
	  Set to the available RAM size

config PAGE_OFFSET
	hex 'Page offset'
	default 0xC0000000
	depends on ARM9
	help
	  Set to the available RAM size


source kernel/Kconfig.hz
source kernel/Kconfig.preempt
source "mm/Kconfig"

config CMDLINE
	string "Default kernel command string"
	default ""
	help
	  On some architectures there is currently no way for the boot loader
	  to pass arguments to the kernel. For these architectures, you should
	  supply some command-line options at build time by entering them
	  here.

menu "Debugging options"

config DEBUG_STACKOVERFLOW
	bool "Check for kernel stack overflow"
	default y
	help
	  Make extra checks for space available on stack in some
	  critical functions. This will cause kernel to run a bit slower,
	  but will catch most of kernel stack overruns and exit gracefuly.

	  Say Y if you are unsure.

config JUMP_UPON_UNHANDLED_EXCEPTION
	bool "Try to die gracefully"
	default y
	help
	  Now this puts kernel into infinite loop after first oops. Till
	  your kernel crashes this doesn't have any influence.

	  Say Y if you are unsure.

endmenu

endmenu

menu "Executable file formats"

source "fs/Kconfig.binfmt"

endmenu

source "net/Kconfig"

source "drivers/Kconfig"

source "fs/Kconfig"

source "security/Kconfig"

source "crypto/Kconfig"

source "lib/Kconfig"

menu "Kernel hacking"

source "lib/Kconfig.debug"

endmenu
```
